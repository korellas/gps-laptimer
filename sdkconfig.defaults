## sdkconfig.defaults
```kconfig
# GPS Laptimer - ESP-IDF Configuration
# Waveshare ESP32-S3-Touch-LCD-3.49

# Target
CONFIG_IDF_TARGET="esp32s3"

# Flash
CONFIG_ESPTOOLPY_FLASHSIZE_16MB=y
CONFIG_ESPTOOLPY_FLASHMODE_QIO=y

# Partition Table
CONFIG_PARTITION_TABLE_CUSTOM=y
CONFIG_PARTITION_TABLE_CUSTOM_FILENAME="partitions.csv"

# Compiler
CONFIG_COMPILER_OPTIMIZATION_PERF=y

# PSRAM (Octal PSRAM)
CONFIG_SPIRAM=y
CONFIG_SPIRAM_MODE_OCT=y
CONFIG_SPIRAM_SPEED_80M=y

# FreeRTOS
CONFIG_FREERTOS_HZ=1000

# USB CDC Console
CONFIG_ESP_CONSOLE_USB_SERIAL_JTAG=y
CONFIG_ESP_CONSOLE_SECONDARY_NONE=y

# Log Level
CONFIG_LOG_DEFAULT_LEVEL_INFO=y
CONFIG_LOG_MAXIMUM_LEVEL_DEBUG=y

# UART for GPS
CONFIG_UART_ISR_IN_IRAM=n

# LVGL Configuration
CONFIG_LV_OS_FREERTOS=y
CONFIG_LV_ATTRIBUTE_FAST_MEM_USE_IRAM=n
CONFIG_LV_FONT_MONTSERRAT_12=y
CONFIG_LV_FONT_MONTSERRAT_14=y
CONFIG_LV_FONT_MONTSERRAT_16=y
CONFIG_LV_FONT_MONTSERRAT_20=y
CONFIG_LV_FONT_MONTSERRAT_24=y
CONFIG_LV_FONT_MONTSERRAT_28=y
CONFIG_LV_FONT_MONTSERRAT_32=y
CONFIG_LV_FONT_MONTSERRAT_36=y
CONFIG_LV_FONT_MONTSERRAT_48=y
CONFIG_LV_USE_FLOAT=y
CONFIG_LV_COLOR_DEPTH_16=y

# SPI LCD Configuration
CONFIG_LCD_SPI_HOST_SPI2=y

# PSRAM Memory Strategy
CONFIG_SPIRAM_USE_MALLOC=y
CONFIG_SPIRAM_MALLOC_ALWAYSINTERNAL=8192

# WiFi Memory Optimization
# NOTE: SPIRAM_TRY_ALLOCATE_WIFI_LWIP forces static TX (kconfig dep) → 내부 RAM 과다 사용
# 대신 dynamic TX 사용 — 필요 시에만 할당/해제되어 ~25KB internal RAM 절약
CONFIG_ESP_WIFI_DYNAMIC_TX_BUFFER=y
CONFIG_ESP_WIFI_DYNAMIC_TX_BUFFER_NUM=24
CONFIG_ESP_WIFI_STATIC_RX_BUFFER_NUM=8
CONFIG_ESP_WIFI_DYNAMIC_RX_BUFFER_NUM=16
CONFIG_ESP_WIFI_RX_MGMT_BUF_NUM_DEF=5

# HTTP Server WebSocket Support
CONFIG_HTTPD_WS_SUPPORT=y

# OTA Rollback Support
CONFIG_BOOTLOADER_APP_ROLLBACK_ENABLE=y

# Bluetooth LE (NimBLE) — BLE OTA 용
CONFIG_BT_ENABLED=y
CONFIG_BT_NIMBLE_ENABLED=y
CONFIG_BT_NIMBLE_MAX_CONNECTIONS=1
CONFIG_BT_NIMBLE_ROLE_CENTRAL=n
CONFIG_BT_NIMBLE_ROLE_OBSERVER=n
CONFIG_BT_NIMBLE_ROLE_BROADCASTER=y
CONFIG_BT_NIMBLE_ROLE_PERIPHERAL=y
CONFIG_BT_NIMBLE_ATT_PREFERRED_MTU=517
CONFIG_BT_NIMBLE_HOST_TASK_STACK_SIZE=8192
CONFIG_BT_NIMBLE_NVS_PERSIST=y

# Disable unnecessary built-in NimBLE services to reduce host load/memory.
CONFIG_BT_NIMBLE_PROX_SERVICE=n
CONFIG_BT_NIMBLE_ANS_SERVICE=n
CONFIG_BT_NIMBLE_CTS_SERVICE=n
CONFIG_BT_NIMBLE_HTP_SERVICE=n
CONFIG_BT_NIMBLE_IPSS_SERVICE=n
CONFIG_BT_NIMBLE_TPS_SERVICE=n
CONFIG_BT_NIMBLE_IAS_SERVICE=n
CONFIG_BT_NIMBLE_LLS_SERVICE=n
CONFIG_BT_NIMBLE_SPS_SERVICE=n
CONFIG_BT_NIMBLE_HR_SERVICE=n
CONFIG_BT_NIMBLE_BAS_SERVICE=n
CONFIG_BT_NIMBLE_DIS_SERVICE=n
```

## sdkconfig.defaults.prod
```kconfig
# GPS Laptimer - Production Build Overrides
#
# Usage (ESP-IDF CMD):
#   idf.py -DSDKCONFIG_DEFAULTS="sdkconfig.defaults;sdkconfig.defaults.prod" build
#
# Windows Ninja (direct):
#   cmake -G Ninja -DSDKCONFIG_DEFAULTS="sdkconfig.defaults;sdkconfig.defaults.prod" ...
#
# These settings override sdkconfig.defaults for production firmware.
# Changes vs development:
#   - Log level: INFO -> WARN (saves ~2-5mA from USB serial output)
#   - Max log level: DEBUG -> WARN (strips debug/info strings from binary)
#   - Assertions: silent (log + continue, no abort on non-critical)

# Log Level: WARN only (suppress INFO in production)
CONFIG_LOG_DEFAULT_LEVEL_WARN=y
CONFIG_LOG_DEFAULT_LEVEL=2

# Maximum compiled log level: WARN (strip DEBUG/INFO strings from flash)
CONFIG_LOG_MAXIMUM_LEVEL_WARN=y
CONFIG_LOG_MAXIMUM_LEVEL=2

# Assertions: silent (ESP_ERROR_CHECK prints but doesn't abort)
CONFIG_COMPILER_OPTIMIZATION_ASSERTIONS_SILENT=y
```
